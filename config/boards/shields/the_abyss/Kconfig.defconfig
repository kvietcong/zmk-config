## config/boards/shields/the_abyss/Kconfig.defconfig
```kconfig
if SHIELD_THE_ABYSS_LEFT

config ZMK_KEYBOARD_NAME
    default "The Abyss"

config ZMK_SPLIT_ROLE_CENTRAL
    default y

endif

if SHIELD_THE_ABYSS_LEFT || SHIELD_THE_ABYSS_RIGHT

config ZMK_SPLIT
    default y

endif
```

## config/boards/shields/the_abyss/Kconfig.shield
```kconfig
config SHIELD_THE_ABYSS_LEFT
    def_bool $(shields_list_contains,the_abyss_left)

config SHIELD_THE_ABYSS_RIGHT
    def_bool $(shields_list_contains,the_abyss_right)
```
